## Kconfig
```kconfig
menu "Pixel fonts"

    config PIXELFONT_FONTS
        string "Bundled fonts"
        default "terminus_8x16,terminus_12x24"
        help
            The fonts to compile into the application, comma separated. The
            names are the file names in the fonts/ directory without the
            "font_" prefix and the ".c" suffix, so "terminus_8x16" means
            fonts/font_terminus_8x16.c.

            Generate a font from a BDF or PSF file with tools/pixelfont.py and
            put the result into fonts/, then add its name here.

    choice PIXELFONT_DEFAULT_FONT
        prompt "Default font"
        default PIXELFONT_DEFAULT_TERMINUS_8X16
        help
            The font that the application uses by default, available as
            PIXELFONT_FONT_DEFAULT.

        config PIXELFONT_DEFAULT_TERMINUS_8X16
            bool "Terminus 8x16"

        config PIXELFONT_DEFAULT_TERMINUS_12X24
            bool "Terminus 12x24"

    endchoice

endmenu
```

## examples/ili9341/main/Kconfig.projbuild
```kconfig
menu "Example configuration"

config EXAMPLE_LCD_PIN_PCLK
    int "SPI clock pin"
    default 12

config EXAMPLE_LCD_PIN_MOSI
    int "SPI data pin"
    default 11

config EXAMPLE_LCD_PIN_CS
    int "Chip select pin"
    default 10

config EXAMPLE_LCD_PIN_DC
    int "Data/command pin"
    default 13

config EXAMPLE_LCD_PIN_RST
    int "Reset pin, -1 when the display has no reset line"
    range -1 48
    default 14

endmenu
```

## examples/ssd1306/main/Kconfig.projbuild
```kconfig
menu "Example configuration"

config EXAMPLE_I2C_SDA
    int "I2C SDA pin"
    range 0 48
    default 21

config EXAMPLE_I2C_SCL
    int "I2C SCL pin"
    range 0 48
    default 22

config EXAMPLE_I2C_ADDR
    hex "I2C address of the display"
    range 0x08 0x77
    default 0x3C
    help
        The 7-bit address of the SSD1306: 0x3c when the D/C pin of the module
        is tied to ground, 0x3d when it is tied to VCC.

endmenu
```
